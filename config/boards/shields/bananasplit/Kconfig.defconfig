## config/boards/shields/bananasplit/Kconfig.defconfig
```kconfig
if SHIELD_BANANASPLIT_LEFT

    config ZMK_KEYBOARD_NAME
        default "bananasplit"

    config ZMK_SPLIT_BLE_ROLE_CENTRAL
        default y
endif

if SHIELD_BANANASPLIT_LEFT || SHIELD_BANANASPLIT_RIGHT

    config ZMK_SPLIT
        default y

endif
```

## config/boards/shields/bananasplit/Kconfig.shield
```kconfig
config SHIELD_BANANASPLIT_LEFT
    def_bool $(shields_list_contains,bananasplit_left)

config SHIELD_BANANASPLIT_RIGHT
    def_bool $(shields_list_contains,bananasplit_right)
```
