// skeletyl_left.overlay

#include "bananasplit.dtsi" // Notice that the main dtsi files are included in the overlay.

&kscan0 {
    col-gpios
        = <&gpio0 2   (GPIO_ACTIVE_HIGH | GPIO_PULL_DOWN) > // col4 in the schematic
        , <&gpio1 15  (GPIO_ACTIVE_HIGH | GPIO_PULL_DOWN) > // col3 in the schematic
        , <&gpio1 13  (GPIO_ACTIVE_HIGH | GPIO_PULL_DOWN) > // col2 in the schematic
        , <&gpio1 11  (GPIO_ACTIVE_HIGH | GPIO_PULL_DOWN) > // col1 in the schematic
        , <&gpio0 10  (GPIO_ACTIVE_HIGH | GPIO_PULL_DOWN) > // col0 in the schematic
        , <&gpio0 9   (GPIO_ACTIVE_HIGH | GPIO_PULL_DOWN) > // col0 in the schematic
        ;
};